## hardware/pixel9-tensor-g4/defconfig
```kconfig
# Aegis OS v0.1 – Google Pixel 9 / 9 Pro XL (Tensor G4) defconfig
# Experimental boot – CCA + MTE on GS201 SoC

CONFIG_ARM64=y
CONFIG_ARM_CCA=y
CONFIG_REALM_MANAGEMENT_EXTENSION=y
CONFIG_MEMORY_TAGGING=y
CONFIG_MTE_BLOCKING_MODE=y

# Tensor G4 / GS201 specific
CONFIG_SOC_GS201=y
CONFIG_EXYNOS_SMC=y
CONFIG_EXYNOS_PMU=y
CONFIG_EXYNOS_CHIPID=y

# Boot chain
CONFIG_OWNER_KEY_PATH="/boot/aegis-owner.pubkey.der"
CONFIG_VERIFY_OWNER_KEY=y
CONFIG_AVB2_VERIFY=y

# UART for early console (USB-C adapter on Pixel 9)
CONFIG_BOOT_UART_BASE=0x0
CONFIG_SEMIHOSTING_UART=0
CONFIG_EARLYCON_USB=y

# Realms
CONFIG_REALM_COMPILER=y
CONFIG_REALM_SHELL=y
CONFIG_REALM_WAYDROID=n  # v0.2

# Security
CONFIG_STACKPROTECTOR_STRONG=y
CONFIG_RANDOMIZE_BASE=y
CONFIG_SHADOW_CALL_STACK=y

# Disable Google blobs
CONFIG_GOOGLE_SERVICES=n
CONFIG_ANDROID_BINDER=n
CONFIG_TRUSTY=n
CONFIG_GKI=n

CONFIG_LOG_LEVEL=5
CONFIG_EARLY_PRINTK=y

# Future
CONFIG_RISCV_SUPPORT=n  # Phase 3
```

## hardware/qrb5165-rb6/defconfig
```kconfig
# Aegis OS v0.1 – Qualcomm RB6 (QCS6490) defconfig
# Primary target – fully supported

CONFIG_ARM64=y
CONFIG_ARM_CCA=y
CONFIG_REALM_MANAGEMENT_EXTENSION=y
CONFIG_MEMORY_TAGGING=y
CONFIG_MTE_BLOCKING_MODE=y

CONFIG_SEMIHOSTING_UART=2
CONFIG_BOOT_UART_BASE=0x00A60000

CONFIG_OWNER_KEY_PATH="/boot/aegis-owner.pubkey.der"
CONFIG_VERIFY_OWNER_KEY=y

CONFIG_REALM_COMPILER=y
CONFIG_REALM_SHELL=y

CONFIG_LOG_LEVEL=4
CONFIG_EARLY_PRINTK=y

# Disable everything we don't own
CONFIG_ANDROID=n
CONFIG_GOOGLE_SERVICES=n
CONFIG_TRUSTY=n
CONFIG_QCOM_SCM=n
```
